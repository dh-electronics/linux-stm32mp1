// SPDX-License-Identifier: (GPL-2.0+ OR BSD-3-Clause)
/*
 * Copyright (C) 2020 Marek Vasut <marex@denx.de>
 */
/dts-v1/;
/plugin/;

/ {
	fragment-0 {
		target-path = "/soc/can@4400e000";
		#address-cells = <1>;
		#size-cells = <1>;
		__overlay__ {
			status = "okay";
		};
	};
};
